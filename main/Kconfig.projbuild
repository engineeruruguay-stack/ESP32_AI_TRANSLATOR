## main/Kconfig.projbuild
```kconfig
menu "Waveshare Audio MVP"
config MVP_WIFI_SSID
    string "Wi-Fi SSID (empty disables Wi-Fi)"
    default ""
config MVP_WIFI_PASSWORD
    string "Wi-Fi password"
    default ""
config MVP_GATEWAY_IP
    string "Test gateway IPv4 address (empty disables streaming)"
    default ""
config MVP_GATEWAY_PORT
    int "Test gateway TCP port"
    range 1 65535
    default 8765
config MVP_ENABLE_WEB
    bool "Enable legacy HTTP panel and unauthenticated OTA on trusted test LAN"
    default n
config MVP_BATTERY_ADC
    bool "Battery sense jumper installed (GPIO1, camera disconnected)"
    default n
endmenu
```

## sdkconfig.defaults
```kconfig
# SDK configuration defaults for ESP32 AI Translator
CONFIG_ESP32S3_DEFAULT_CPU_FREQ_240=y
CONFIG_LOG_DEFAULT_LEVEL_INFO=y
CONFIG_ESP_SYSTEM_EVENT_QUEUE_SIZE=32
CONFIG_ESP_SYSTEM_EVENT_TASK_STACK_SIZE=4096

CONFIG_PARTITION_TABLE_CUSTOM=y
CONFIG_PARTITION_TABLE_CUSTOM_FILENAME="partitions.csv"
CONFIG_PARTITION_TABLE_FILENAME="partitions.csv"
CONFIG_BOOTLOADER_APP_ROLLBACK_ENABLE=y

CONFIG_ESPTOOLPY_FLASHSIZE_16MB=y
CONFIG_ESPTOOLPY_FLASHSIZE="16MB"
CONFIG_ESP_CONSOLE_USB_SERIAL_JTAG=y
CONFIG_FATFS_LFN_HEAP=y
CONFIG_ESP_MAIN_TASK_STACK_SIZE=32768
CONFIG_SPIRAM=y
CONFIG_SPIRAM_MODE_OCT=y
CONFIG_SPIRAM_SPEED_80M=y
CONFIG_SPIRAM_USE_CAPS_ALLOC=y
CONFIG_UAC_SPEAKER_CHANNEL_NUM=2
CONFIG_UAC_MIC_CHANNEL_NUM=0
CONFIG_UAC_SAMPLE_RATE=48000
CONFIG_UAC_SUPPORT_MACOS=y
CONFIG_UAC_TUSB_PRODUCT="Waveshare USB Audio"
```
